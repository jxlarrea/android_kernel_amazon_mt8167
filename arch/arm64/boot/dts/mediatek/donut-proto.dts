/*
 * Copyright (C) 2018 Amazon.com
 *
 * This program is free software: you can redistribute it and/or modify
 * it under the terms of the GNU General Public License version 2 as
 * published by the Free Software Foundation.
 *
 * This program is distributed in the hope that it will be useful,
 * but WITHOUT ANY WARRANTY; without even the implied warranty of
 * MERCHANTABILITY or FITNESS FOR A PARTICULAR PURPOSE. See the
 * GNU General Public License for more details.
 *
 */

/dts-v1/;

#include "donut.dtsi"

/ {
	model = "Amazon Donut Proto";
	compatible = "amzn,donut-proto", "amzn,donut";
};

&i2c2 {
	codec: tlv320aic32x4@18 {
		compatible = "ti,tlv320aic32x4";
		reg = <0x18>;
		reset-gpios = <&pio 10 0>;
	};
};

/delete-node/ &is31fl32363fled;
